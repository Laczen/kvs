## CMakeLists.txt
```
# SPDX-License-Identifier: Apache-2.0

cmake_minimum_required(VERSION 3.20.0)

find_package(Zephyr REQUIRED HINTS $ENV{ZEPHYR_BASE})
project(kvs_settings_sample)

target_sources(app PRIVATE src/main.c)
```

## prj.conf
```kconfig
CONFIG_FLASH=y
CONFIG_FLASH_PAGE_LAYOUT=y
CONFIG_KVS=y
CONFIG_KVS_BACKEND_FLASH=y
CONFIG_LOG=y
CONFIG_LOG_MODE_MINIMAL=y
CONFIG_SHELL=y
CONFIG_SHELL_BACKEND_SERIAL=y
CONFIG_SETTINGS_SHELL=y
CONFIG_SETTINGS=y
CONFIG_SETTINGS_CUSTOM=y
CONFIG_SETTINGS_KVS=y
```

## boards/nucleo_f411re.conf
```kconfig
CONFIG_SHELL_MINIMAL=y
```

## boards/nrf52dk_nrf52832.overlay
```dts
/*
 * Copyright (c) 2023 Laczen
 * SPDX-License-Identifier: Apache-2.0
 */

/ {
        kvs_storage: kvs_storage {
                compatible = "zephyr,kvs-flash";
                partition = <&storage_partition>;
                block-size = <DT_SIZE_K(4)>;
                free-size = <DT_SIZE_K(4)>;
        };
};
```

## boards/qemu_x86.overlay
```dts
/*
 * Copyright (c) 2023 Laczen
 * SPDX-License-Identifier: Apache-2.0
 */
 
 / {
        kvs_storage: kvs_storage {
                compatible = "zephyr,kvs-flash";
                partition = <&storage_partition>;
                block-size = <4096>;
                free-size = <16384>;
        };
 };
```

## src/main.c
```c
/*
 * Copyright (c) 2012-2014 Wind River Systems, Inc.
 *
 * SPDX-License-Identifier: Apache-2.0
 */

#include <zephyr/kernel.h>
#include <zephyr/logging/log.h>
#include <zephyr/settings/settings.h>

LOG_MODULE_REGISTER(kvs_sample);

int main(void)
{
	int rc;
	
	rc = settings_subsys_init();
	LOG_INF("Settings subsys init [%d]", rc);
#if DT_NODE_HAS_COMPAT(DT_CHOSEN(zephyr_shell_uart), zephyr_cdc_acm_uart)
	const struct device *dev;
	uint32_t dtr = 0;

	dev = DEVICE_DT_GET(DT_CHOSEN(zephyr_shell_uart));
	if (!device_is_ready(dev) || usb_enable(NULL)) {
		return 0;
	}

	while (!dtr) {
		uart_line_ctrl_get(dev, UART_LINE_CTRL_DTR, &dtr);
		k_sleep(K_MSEC(100));
	}
#endif
	return 0;
}
```
