/*
 * Copyright (c) 2023 Laczen
 * SPDX-License-Identifier: Apache-2.0
 */
 
 / {
        kvs_storage: kvs_storage {
                compatible = "zephyr,kvs-flash";
                partition = <&storage_partition>;
                block-size = <DT_SIZE_K(16)>;
                free-size = <DT_SIZE_K(16)>;
        };
 };