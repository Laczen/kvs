## zephyr/Kconfig
```kconfig
# Kconfig - key value store - kvs
#
# Copyright (c) 2022 Laczen
#
# SPDX-License-Identifier: Apache-2.0
#

config KVS
	bool "Key Value Store - kvs"
	help
	  Enable support of kvs.

if KVS

rsource "subsys/kvs/Kconfig"

endif # KVS

config SETTINGS_KVS
	bool "Settings on KVS"
        depends on SETTINGS
	select KVS
	help
	  Use KVS as the settings backend.

if SETTINGS_KVS

rsource "subsys/settings/Kconfig"

endif # SETTINGS_KVS
```

## zephyr/dts/bindings/misc/zephyr,kvs-eeprom.yaml
```yaml
# Copyright (c) 2023 Laczen
# SPDX-License-Identifier: Apache-2.0

description: Key Value Store on eeprom

compatible: "zephyr,kvs-eeprom"

include: base.yaml

properties:
  eeprom:
    type: phandle
    required: true
    description: |
      Backing storage eeprom.
  
  eeprom-offset:
    type: int
    default: 0
    description: |
      When only a part of the eeprom is to be used for kvs storage the offset in
      the eeprom can be specified here.

  size:
    type: int
    description: |
      When only a part of the eeprom is to be used for kvs storage the size can
      be specified here. When unspecified the size is from eeprom-offset to the
      end of the eeprom.

  block-size:
    type: int
    required: true
    description: |
      The block-size specifies how to divide the eeprom into blocks. The 
      block-size should be a power of 2.
```

## zephyr/dts/bindings/misc/zephyr,kvs-flash.yaml
```yaml
# Copyright (c) 2023 Laczen
# SPDX-License-Identifier: Apache-2.0

description: Key Value Store on flash partition

compatible: "zephyr,kvs-flash"

include: base.yaml

properties:
  partition:
    type: phandle
    required: true
    description: |
      Backing storage flash partition.

  block-size:
    type: int
    required: true
    description: |
      The block-size specifies how to divide the flash partition into blocks.
      The block-size should be a power of 2.

  free-size:
    type: int
    description: |
      To ensure no data is lost during garbage collection some area should 
      always be free. As flash needs to be erased before being written this size
      should at least be equal to the largest erase block size of the flash
      partition. Defaults to block-size if omitted
```

## zephyr/subsys/settings/Kconfig
```kconfig
# Copyright (c) 2023 Laczen
# SPDX-License-Identifier: Apache-2.0

if SETTINGS_KVS

module = SETTINGS_KVS
module-str = settings_kvs
source "subsys/logging/Kconfig.template.log_config"

endif
```
